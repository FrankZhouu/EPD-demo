## prj.conf
```kconfig
CONFIG_LV_Z_MEM_POOL_SIZE=16384
CONFIG_LV_Z_SHELL=y
CONFIG_SHELL=y
CONFIG_KERNEL_SHELL=y
CONFIG_MAIN_STACK_SIZE=4096

CONFIG_DISPLAY=y
CONFIG_DISPLAY_LOG_LEVEL_ERR=y

CONFIG_LOG=y
CONFIG_SHELL=y

CONFIG_LVGL=y
CONFIG_LV_MEM_CUSTOM=y
CONFIG_LV_USE_LOG=y
CONFIG_LV_USE_LABEL=y
# CONFIG_LV_FONT_MONTSERRAT_14=y
CONFIG_LV_FONT_MONTSERRAT_16=y

CONFIG_GPIO=y

CONFIG_BT=y
CONFIG_BT_PERIPHERAL=y
CONFIG_BT_DEVICE_NAME="NRF52840DK"
CONFIG_BT_MAX_CONN=64
CONFIG_BT_GATT_CLIENT=y
# CONFIG_BT_L2CAP_LOG_LEVEL_DBG=y
CONFIG_BT_BUF_ACL_RX_SIZE=304

CONFIG_BT_L2CAP_TX_MTU=300

# #USB related configs
# CONFIG_STDOUT_CONSOLE=y
# CONFIG_USB_DEVICE_STACK=y
# CONFIG_USB_DEVICE_PRODUCT="Zephyr MSC sample"
# CONFIG_USB_DEVICE_PID=0x0008
# CONFIG_LOG=y
# CONFIG_USB_DRIVER_LOG_LEVEL_ERR=y
# CONFIG_USB_MASS_STORAGE=y
# CONFIG_USB_DEVICE_LOG_LEVEL_ERR=y
# CONFIG_USB_MASS_STORAGE_LOG_LEVEL_ERR=y
# CONFIG_USB_DEVICE_INITIALIZE_AT_BOOT=n
# CONFIG_APP_MSC_STORAGE_FLASH_FATFS=y

# CONFIG_DISK_DRIVER_SDMMC=n
# CONFIG_LV_Z_USE_FILESYSTEM=y
```

## src/main.c
```c
/*
 * Copyright (c) 2018 Jan Van Winkel <jan.van_winkel@dxplore.eu>
 *
 * SPDX-License-Identifier: Apache-2.0
 */

#include "core/lv_obj_pos.h"
#include <zephyr/device.h>
#include <zephyr/devicetree.h>
#include <zephyr/drivers/display.h>
#include <zephyr/drivers/gpio.h>
#include <lvgl.h>
#include <stdint.h>
#include <stdbool.h>
#include <string.h>
#include <zephyr/kernel.h>
#include <lvgl_input_device.h>
#include <zephyr/shell/shell.h>

#define LOG_LEVEL CONFIG_LOG_DEFAULT_LEVEL
#include <zephyr/logging/log.h>
LOG_MODULE_REGISTER(app);

extern uint8_t rx_data[384];
extern bool data_received;
extern int bt_init(void);

static lv_obj_t *label;
static bool refresh = 0;
uint8_t button_pressed = 0;/* 0 means sw0,1 means sw1 */

#define LED0_NODE DT_ALIAS(led0)
static const struct gpio_dt_spec led = GPIO_DT_SPEC_GET(LED0_NODE, gpios);

#ifdef CONFIG_GPIO
static struct gpio_dt_spec button0_gpio = GPIO_DT_SPEC_GET_OR(
		DT_ALIAS(sw0), gpios, {0});
static struct gpio_callback button0_callback;

static struct gpio_dt_spec button1_gpio = GPIO_DT_SPEC_GET_OR(
	DT_ALIAS(sw1), gpios, {0});
static struct gpio_callback button1_callback;

static void button_isr_callback(const struct device *port,
				struct gpio_callback *cb,
				uint32_t pins)
{
	if (pins & BIT(button0_gpio.pin)) {
		button_pressed = 0;
	} else if (pins & BIT(button1_gpio.pin)) {
		button_pressed = 1;
	}
	refresh = 1;

}
#endif /* CONFIG_GPIO */

int button_init(const struct gpio_dt_spec *spec, struct gpio_callback *callback,
				gpio_callback_handler_t handler)
{
	if (!gpio_is_ready_dt(spec)) {
		LOG_ERR("Error: %s is not a valid GPIO device", spec->port->name);
		return -ENODEV;
	}

	int err;

	err = gpio_pin_configure_dt(spec, GPIO_INPUT);
	if (err) {
		LOG_ERR("failed to configure button gpio: %d", err);
		return -1;
	}

	gpio_init_callback(callback, handler, BIT(spec->pin));

	err = gpio_add_callback(spec->port, callback);
	if (err) {
		LOG_ERR("failed to add button callback: %d", err);
		return -1;
	}

	err = gpio_pin_interrupt_configure_dt(spec, GPIO_INT_EDGE_TO_ACTIVE);
	if (err) {
		LOG_ERR("failed to enable button callback: %d", err);
		return -1;
	}

	return 0;
}

int main(void)
{
	LOG_INF("LVGL Zephyr application started V0.1");

	int ret;

	if (!gpio_is_ready_dt(&led)) {
		return 0;
	}

	ret = gpio_pin_configure_dt(&led, GPIO_OUTPUT_ACTIVE);
	if (ret < 0) {
		return 0;
	}

	const struct device *display_dev = DEVICE_DT_GET(DT_CHOSEN(zephyr_display));
	if (!device_is_ready(display_dev)) {
		LOG_ERR("Device not ready, aborting test");
		return 0;
	}

	struct display_capabilities cap;
	display_get_capabilities(display_dev, &cap);
	LOG_INF("Display resolution: %dx%d", cap.x_resolution, cap.y_resolution);

#ifdef CONFIG_BT
	int err;
	err = bt_init();
	if (err) {
		LOG_ERR("Bluetooth init failed (err %d)", err);
		return 0;
	}
#endif

#ifdef CONFIG_GPIO
	ret = button_init(&button0_gpio, &button0_callback, button_isr_callback);
	if (ret) {
		LOG_ERR("Failed to initialize button0");
		return -1;
	}

	ret = button_init(&button1_gpio, &button1_callback, button_isr_callback);
	if (ret) {
		LOG_ERR("Failed to initialize button1");
		return -1;
	}
#endif /* CONFIG_GPIO */

	label = lv_label_create(lv_scr_act());
	static lv_style_t style;
	lv_style_init(&style);
	lv_style_set_text_font(&style, &lv_font_montserrat_16);
	lv_obj_add_style(label, &style, LV_PART_MAIN);

	lv_label_set_text(label, "This is a simple EPD demo.");
	lv_obj_align(label, LV_ALIGN_TOP_LEFT, 0, 0);
	lv_obj_set_width(label, cap.x_resolution);
	lv_label_set_long_mode(label, LV_LABEL_LONG_WRAP);

	lv_task_handler();
	display_blanking_off(display_dev);

	while(1)
	{
		if (data_received) {
            data_received = false;
			lv_label_set_text(label, rx_data);
			lv_task_handler();
			memset(rx_data, 0, sizeof(rx_data));
        }

		if (refresh) {
			refresh = 0;
			if (button_pressed == 0) {
				lv_label_set_text(label, "Button 0 pressed");
			} else {
				lv_label_set_text(label, "Button 1 pressed");
			}
			lv_task_handler();
		}
		k_sleep(K_MSEC(10));
	}
}

static int cmd_refresh(const struct shell *shell, size_t argc, char **argv)
{
	ARG_UNUSED(argc);

	memset(rx_data, 0, sizeof(rx_data));
	strncpy(rx_data, argv[1], sizeof(argv) - 1);
	rx_data[sizeof(rx_data) - 1] = '\0';
	lv_label_set_text(label, rx_data);
	lv_task_handler();

	shell_print(shell, "refresh screen: %s", rx_data);
	return 0;
}

SHELL_CMD_REGISTER(refresh, NULL, "refresh the screen", cmd_refresh);
```

## src/bt.c
```c
#include <zephyr/kernel.h>

#include <zephyr/bluetooth/bluetooth.h>
#include <zephyr/bluetooth/uuid.h>
#include <zephyr/bluetooth/gatt.h>
#include <zephyr/bluetooth/hci.h>
#include <zephyr/bluetooth/conn.h>
#include <zephyr/sys/util.h>

#define LOG_LEVEL CONFIG_LOG_DEFAULT_LEVEL
#include <zephyr/logging/log.h>
LOG_MODULE_REGISTER(bt_app);

#ifdef CONFIG_BT
#define BT_UUID_WRITE_SERVICE \
BT_UUID_128_ENCODE(0x6E400001, 0xB5A3, 0xF393, 0xE0A9, 0xE50E24DCCA9E)

#define BT_UUID_WRITE_VAL \
BT_UUID_128_ENCODE(0x6E400002, 0xB5A3, 0xF393, 0xE0A9, 0xE50E24DCCA9E)

#define BT_MTU_UPDATE_SERVICE BT_UUID_128_ENCODE(0x2e2b8dc3, 0x06e0, 0x4f93, 0x9bb2, 0x734091c356f0)

/* Overhead: opcode (u8) + handle (u16) */
#define ATT_NTF_SIZE(payload_len) (1 + 2 + payload_len)

static struct bt_uuid_128 write_service_uuid = BT_UUID_INIT_128(BT_UUID_WRITE_SERVICE);
static struct bt_uuid_128 write_uuid = BT_UUID_INIT_128(BT_UUID_WRITE_VAL);
static const struct bt_uuid_128 mtu_update_service = BT_UUID_INIT_128(BT_MTU_UPDATE_SERVICE);

static const struct bt_uuid_128 notify_characteristic_uuid =
	BT_UUID_INIT_128(BT_UUID_128_ENCODE(0x2e2b8dc3, 0x06e0, 0x4f93, 0x9bb2, 0x734091c356f3));

uint8_t rx_data[248];
bool data_received = false;
static struct bt_conn *default_conn;

static ssize_t write_handler(struct bt_conn *conn, const struct bt_gatt_attr *attr,
	const void *buf, uint16_t len, uint16_t offset, uint8_t flags)
{

	LOG_INF("write_handler: len %d, offset %d", len, offset);
	if (offset > 0) {
		return BT_GATT_ERR(BT_ATT_ERR_INVALID_OFFSET);
	}

	if (len > sizeof(rx_data)) {
		LOG_INF("write_handler: invalid len %d", len);
		return BT_GATT_ERR(BT_ATT_ERR_INVALID_ATTRIBUTE_LEN);
	}

	memcpy(rx_data, buf, len);
	rx_data[len] = '\0';
	data_received = true;

	LOG_INF("Received data: %s", rx_data);
	return len;
}

BT_GATT_SERVICE_DEFINE(write_service, BT_GATT_PRIMARY_SERVICE(&write_service_uuid),
BT_GATT_CHARACTERISTIC(&write_uuid.uuid, BT_GATT_CHRC_WRITE, BT_GATT_PERM_WRITE,
			            NULL, write_handler, NULL),
);

static const struct bt_data ad[] = {
BT_DATA_BYTES(BT_DATA_FLAGS, (BT_LE_AD_GENERAL | BT_LE_AD_NO_BREDR)),
BT_DATA_BYTES(BT_DATA_UUID128_ALL, BT_MTU_UPDATE_SERVICE),
BT_DATA(BT_DATA_NAME_COMPLETE, CONFIG_BT_DEVICE_NAME, sizeof(CONFIG_BT_DEVICE_NAME) - 1),
};

static void ccc_cfg_changed(const struct bt_gatt_attr *attr, uint16_t value)
{
	ARG_UNUSED(attr);

	bool notif_enabled = (value == BT_GATT_CCC_NOTIFY);

	printk("MTU Test Update: notifications %s\n", notif_enabled ? "enabled" : "disabled");
}

BT_GATT_SERVICE_DEFINE(mtu_UPDATE, BT_GATT_PRIMARY_SERVICE(&mtu_update_service),
		       BT_GATT_CHARACTERISTIC(&notify_characteristic_uuid.uuid, BT_GATT_CHRC_NOTIFY,
					      BT_GATT_PERM_NONE, NULL, NULL, NULL),
		       BT_GATT_CCC(ccc_cfg_changed, BT_GATT_PERM_READ | BT_GATT_PERM_WRITE));

static void mtu_updated(struct bt_conn *conn, uint16_t tx, uint16_t rx)
{
	printk("Updated MTU: TX: %d RX: %d bytes\n", tx, rx);
}

static struct bt_gatt_cb gatt_callbacks = {
	.att_mtu_updated = mtu_updated
};

static void connected(struct bt_conn *conn, uint8_t err)
{
	if (err) {
		LOG_ERR("Connection failed (err %u)", err);
		return;
	}
	default_conn = bt_conn_ref(conn);
	LOG_INF("Connected");
}

static void disconnected(struct bt_conn *conn, uint8_t reason)
{
	LOG_INF("Disconnected (reason %u)", reason);

	bt_conn_unref(conn);
	default_conn = NULL;
	bt_le_adv_stop();

    int err = bt_le_adv_start(BT_LE_ADV_CONN_FAST_1, ad, ARRAY_SIZE(ad), NULL, 0);
    if (err) {
        printk("Restart advertising failed (err %d)\n", err);
    } else {
        printk("Advertising restarted\n");
    }
}

BT_CONN_CB_DEFINE(conn_callbacks) = {
	.connected = connected,
	.disconnected = disconnected,
};

int bt_init(void)
{
    int err;

    err = bt_enable(NULL);
    if (err) {
        LOG_ERR("Bluetooth init failed (err %d)", err);
        return -1;
    }

	printk("Bluetooth initialized\n");

    bt_gatt_cb_register(&gatt_callbacks);
	struct bt_gatt_attr *notify_crch =
		bt_gatt_find_by_uuid(mtu_UPDATE.attrs, 0xffff, &notify_characteristic_uuid.uuid);

	err = bt_le_adv_start(BT_LE_ADV_CONN_FAST_1, ad, ARRAY_SIZE(ad), NULL, 0);
	if (err) {
		printk("Advertising failed to start (err %d)\n", err);
        return -1;
    }

	printk("Advertising successfully started\n");

    uint8_t notify_data[100] = {};

	notify_data[13] = 0x7f;
	notify_data[99] = 0x55;

    k_sleep(K_SECONDS(1));
    /* Only send the notification if the UATT MTU supports the required length */
    if (bt_gatt_get_uatt_mtu(default_conn) >= ATT_NTF_SIZE(sizeof(notify_data))) {
        bt_gatt_notify(default_conn, notify_crch, notify_data, sizeof(notify_data));
    } else {
        printk("Skipping notification since UATT MTU is not sufficient."
                "Required: %d, Actual: %d\n",
                ATT_NTF_SIZE(sizeof(notify_data)),
                bt_gatt_get_uatt_mtu(default_conn));
    }

    return 0;
}
#endif
```
